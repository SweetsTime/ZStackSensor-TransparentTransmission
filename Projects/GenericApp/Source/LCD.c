/*******************************************************************************
 * 文件名称：LCD.c
 * 功    能：数码管驱动
 *           
 * 硬件连接：数码管与CC2530的硬件连接关系如下：
 *             
 *
 *               SPI-data 串行数据             P1.6
 *               SPI-CLK  移位寄存器时钟输入   P1.5
 *               GPH      存储寄存器时钟输入   P1.3
 * 作    者：w
 * 公    司：无锡泛太科技有限公司
 ******************************************************************************/

/* 包含头文件 */
/********************************************************************/
#include "ioCC2530.h"
#include "LCD.h"
/*****************************************************************/

/*********************************************************************
 * 函数名称：LCD_SPILEDSendData
 * 功    能：通过串行SPI口输送一个byte的数据置模组
 * 入口参数：Data  要传送的数据
 * 出口参数：temp
 * 返 回 值：SPI接到数据
 ********************************************************************/
void LCD_SPILEDSendData(unsigned char Data)
{
  unsigned char  i;
  for(i=0;i<8;i++)
  { L_SPILEDCLK();
    SPILEDdata=((Data&0x80)>>7);
    NOP();
    H_SPILEDCLK();
    Data<<=1;
  }
}
/*********************************************************************
 * 函数名称：LCD_SPILEDSendDatal
 * 功    能：通过串行SPI口输送一个byte的数据置模组
 * 入口参数：Data  要传送的数据
 * 出口参数：temp
 * 返 回 值：SPI接到数据
 ********************************************************************/
void LCD_SPILEDSendDatal(unsigned char Data)
{
  unsigned char  i;
  for(i=0;i<8;i++)
  { L_SPILEDCLK();
    SPILEDdata=(Data&0x01);
    NOP();
    H_SPILEDCLK();
    Data>>=1;
  }
}
/*********************************************************************
 * 函数名称：LCD_SPILEDOUT
 * 功    能：595数据输出
 * 入口参数：
 * 出口参数：
 * 返 回 值：
 ********************************************************************/
void LCD_SPILEDOUT(void)
{
    L_GPH();
    NOP();
    H_GPH();

}
/*********************************************************************
 * 函数名称：LCD_SPILEDOUT
 * 功    能：595数据输出
 * 入口参数：
 * 出口参数：
 * 返 回 值：
 ********************************************************************/
void SendData(unsigned char Data)
{
  LCD_SPILEDSendData(Data);
  LCD_SPILEDOUT();
}
/*********************************************************************
 * 函数名称：SendDataS
 * 功    能：595数据输出
 * 入口参数：
 * 出口参数：
 * 返 回 值：
 ********************************************************************/
void SendDataS(unsigned char * Data,unsigned char len)
{char i;
  for(i=0;i<len;i++)
  LCD_SPILEDSendDatal(Data[len-i-1]);
  LCD_SPILEDOUT();
}
